## amd-defconfig
```kconfig
CONFIG_SND_SOC_SOF_AMD_TOPLEVEL=m
CONFIG_SND_SOC_SOF_AMD_RENOIR=m
CONFIG_SND_SOC_SOF_AMD_REMBRANDT=m
CONFIG_SND_AMD_ACP_CONFIG=m
CONFIG_SND_SOC_SOF_AMD_VANGOGH=m
CONFIG_SND_SOC_SOF_AMD_ACP63=m
CONFIG_SND_SOC_AMD_PS=m
```

## avs-defconfig
```kconfig
# Enable AVS audio driver
CONFIG_SND_SOC_INTEL_AVS=m

# Enable AVS boards
CONFIG_SND_SOC_INTEL_AVS_MACH_DA7219=m
CONFIG_SND_SOC_INTEL_AVS_MACH_DMIC=m
CONFIG_SND_SOC_INTEL_AVS_MACH_HDAUDIO=m
CONFIG_SND_SOC_INTEL_AVS_MACH_I2S_TEST=m
CONFIG_SND_SOC_INTEL_AVS_MACH_MAX98357A=m
CONFIG_SND_SOC_INTEL_AVS_MACH_MAX98373=m
CONFIG_SND_SOC_INTEL_AVS_MACH_NAU8825=m
CONFIG_SND_SOC_INTEL_AVS_MACH_RT274=m
CONFIG_SND_SOC_INTEL_AVS_MACH_RT286=m
CONFIG_SND_SOC_INTEL_AVS_MACH_RT298=m
CONFIG_SND_SOC_INTEL_AVS_MACH_RT5682=m
CONFIG_SND_SOC_INTEL_AVS_MACH_SSM4567=m
```

## base-defconfig
```kconfig
CONFIG_EXPERT=y
CONFIG_DYNAMIC_DEBUG=y
CONFIG_PM_ADVANCED_DEBUG=y

CONFIG_FW_LOADER_COMPRESS=y
CONFIG_FW_LOADER_COMPRESS_ZSTD=y

CONFIG_BUILD_SALT=""

# General configuration
CONFIG_USER_NS=y

# Thermal
CONFIG_THERMAL=y
CONFIG_THERMAL_GOV_STEP_WISE=y
CONFIG_THERMAL_GOV_USER_SPACE=y

# Core temperature sensor
CONFIG_SENSORS_CORETEMP=y

# This default value (and many others) were changed by upstream commit:
#   410ce3dd5055b x86/config: Make the x86 defconfigs a bit more usable
# Disable it again.
# CONFIG_HYPERVISOR_GUEST is not set

# SElinux
CONFIG_SECURITY_SELINUX_DISABLE=y

# Required to boot some Fedora spins with default settings.
CONFIG_DM_THIN_PROVISIONING=y
CONFIG_XFS_FS=y
CONFIG_IOSCHED_BFQ=y

# Memory management
CONFIG_FRONTSWAP=y

# Need this when graphics fail (don't forget to drop "quiet splash"
# in the grub config)

# Even when graphics work, without a framebuffer console `chvt` still
# works but it is "blind" / with a frozen GUI instead! Incredibly
# confusing. Linux distributions expect this.
CONFIG_FB=y
CONFIG_FRAMEBUFFER_CONSOLE=y
# add support for using the EFI framebuffer as console
CONFIG_FB_EFI=y
# FB emulation appears to be needed for HDMI audio (!) support and
# it is not enabled default since 6.7.0-rc1
CONFIG_DRM_FBDEV_EMULATION=y

# sudo modprobe configs && zgrep SOF_DEBUG /proc/config.gz
CONFIG_IKCONFIG=m
CONFIG_IKCONFIG_PROC=y

# Enable OF match for PRP0001 ACPI devices
CONFIG_OF=y

# EFI
CONFIG_EFI_STUB=y
CONFIG_EFI_MIXED=y

# DEVMEM - disable strict for debug - don't use for distros!!
CONFIG_STRICT_DEVMEM=n

# LPSS
CONFIG_X86_INTEL_LPSS=y
CONFIG_MFD_CORE=m
CONFIG_MFD_INTEL_LPSS=m
CONFIG_MFD_INTEL_LPSS_ACPI=m
CONFIG_MFD_INTEL_LPSS_PCI=m

# GPIO
CONFIG_GPIOLIB=y
CONFIG_GPIO_ACPI=y
CONFIG_GPIOLIB_IRQCHIP=y
CONFIG_GPIO_SYSFS=y
CONFIG_GPIO_DEBUG=y

# PINCTRL
CONFIG_PINCTRL=y
CONFIG_PINCTRL_BAYTRAIL=y
CONFIG_PINCTRL_CHERRYVIEW=y
CONFIG_PINCTRL_BROXTON=y
CONFIG_PINCTRL_CANNONLAKE=y
CONFIG_PINCTRL_GEMINILAKE=y
CONFIG_PINCTRL_ICELAKE=y
CONFIG_PINCTRL_JASPERLAKE=y
CONFIG_PINCTRL_SUNRISEPOINT=y
CONFIG_PINCTRL_TIGERLAKE=y
# CONFIG_PINCTRL_ELKHARTLAKE=y
CONFIG_PINCTRL_ALDERLAKE=y
CONFIG_PINCTRL_METEORLAKE=y

# DesignWare
CONFIG_DW_DMAC=y
CONFIG_DW_DMAC_PCI=y
CONFIG_I2C_DESIGNWARE_PLATFORM=y

# I2C
CONFIG_I2C_CHARDEV=y

# SPI
CONFIG_SPI=y
# CONFIG_SPI_DEBUG is not set
CONFIG_SPI_MASTER=y

CONFIG_REGMAP_SPI=y
CONFIG_SPI_DESIGNWARE=m
CONFIG_SPI_DW_PCI=m
CONFIG_SPI_DW_MID_DMA=y
CONFIG_SPI_DW_MMIO=m

# SOUND
CONFIG_SOUND=m
CONFIG_SND=m
CONFIG_SND_VERBOSE_PRINTK=y
CONFIG_SND_DEBUG=y
CONFIG_SND_CTL_VALIDATION=y
# CONFIG_SND_DRIVERS is not set
# CONFIG_SND_SPI is not set
# CONFIG_SND_PCMCIA is not set
CONFIG_SND_SOC=m
CONFIG_SND_SOC_ACPI=m
CONFIG_SND_SOC_ACPI_INTEL_MATCH=m

# DRM
CONFIG_DRM=m
CONFIG_DRM_I915_ALPHA_SUPPORT=y

# Intel ME
CONFIG_INTEL_MEI=m
CONFIG_INTEL_MEI_ME=m
CONFIG_INTEL_MEI_TXE=m
CONFIG_INTEL_MEI_GSC=m
CONFIG_INTEL_MEI_GSC_PROXY=m

#
# Intel thermal drivers
#
CONFIG_INTEL_POWERCLAMP=m
CONFIG_X86_PKG_TEMP_THERMAL=m
CONFIG_INTEL_SOC_DTS_THERMAL=m

#
# ACPI INT340X thermal drivers
#
CONFIG_INT340X_THERMAL=m
CONFIG_INT3406_THERMAL=m
CONFIG_INTEL_PCH_THERMAL=m

#
# Generic IOMMU Pagetable Support
#
CONFIG_INTEL_IOMMU_SVM=y
CONFIG_IRQ_REMAP=y

# Buttons and LEDs
CONFIG_THINKPAD_ACPI=m
CONFIG_THINKPAD_ACPI_ALSA_SUPPORT=y

CONFIG_DELL_SMBIOS=m
CONFIG_DCDBAS=m
CONFIG_DELL_LAPTOP=m
CONFIG_DELL_WMI=m

CONFIG_LEDS_TRIGGERS=y
CONFIG_LEDS_TRIGGER_AUDIO=m

# USB Sound Card Support
CONFIG_SND_USB=y
CONFIG_SND_USB_AUDIO=m

# HDMI audio needed for BYT/CHT
CONFIG_HDMI_LPE_AUDIO=m

# Enable legacy audio drivers
CONFIG_SND_SOC_INTEL_CATPT=m
CONFIG_SND_SST_ATOM_HIFI2_PLATFORM_ACPI=m
CONFIG_SND_SOC_INTEL_SKYLAKE=m
CONFIG_SND_SOC_INTEL_SKYLAKE_HDAUDIO_CODEC=y

# needed for Broadwell
CONFIG_ACPI_REV_OVERRIDE_POSSIBLE=n

# TigerLake support
CONFIG_PCI_IOV=y
CONFIG_VMD=m
CONFIG_PCIE_DW=y
CONFIG_PCIE_DW_HOST=y
CONFIG_PCIE_DW_PLAT=y
CONFIG_PCIE_DW_PLAT_HOST=y
CONFIG_INTEL_IDMA64=m

# Scheduling
# after 5.16-rc1, PREEMPT_VOLUNTARY is the default, but this raises problems
# with interrupts
# https://github.com/thesofproject/linux/issues/3283
# to be bug-compatible with previous releases, PREEMPT is selected explicitly.
# This should be removed when these issues are resolved.
CONFIG_PREEMPT_NONE=n
CONFIG_PREEMPT_VOLUNTARY=n
CONFIG_PREEMPT=y

# Powertop wants devfreq
CONFIG_PM_DEVFREQ=y
CONFIG_DEVFREQ_GOV_SIMPLE_ONDEMAND=m
CONFIG_DEVFREQ_GOV_PERFORMANCE=m
CONFIG_DEVFREQ_GOV_POWERSAVE=m
CONFIG_DEVFREQ_GOV_USERSPACE=m
CONFIG_DEVFREQ_GOV_PASSIVE=m

# some systems are locked to X86_X2APIC and can not fall back to the
#  legacy APIC modes if SGX or TDX are enabled in the BIOS
CONFIG_X86_X2APIC=y
```

## bpf-defconfig
```kconfig
# From https://github.com/iovisor/bpftrace/blob/master/INSTALL.md#linux-kernel-requirements
# Removed uprobe-related options (those are for userspace tracing)

CONFIG_BPF=y
CONFIG_BPF_SYSCALL=y
CONFIG_BPF_JIT=y
CONFIG_HAVE_EBPF_JIT=y
CONFIG_BPF_EVENTS=y
CONFIG_FTRACE_SYSCALLS=y
CONFIG_FUNCTION_TRACER=y
CONFIG_HAVE_DYNAMIC_FTRACE=y
CONFIG_DYNAMIC_FTRACE=y
CONFIG_HAVE_KPROBES=y
CONFIG_KPROBES=y
CONFIG_KPROBE_EVENTS=y
CONFIG_DEBUG_FS=y
```

## devices-defconfig
```kconfig
# File systems
CONFIG_BTRFS_FS=y
CONFIG_BTRFS_FS_POSIX_ACL=y
CONFIG_FUSE_FS=m

# Required by Ubuntu snaps. Avoids a systemctl "degraded" state due to
# failed snap-*.mount (each snap package has one squashfs mount)
CONFIG_SQUASHFS=m
CONFIG_SQUASHFS_XATTR=y
CONFIG_SQUASHFS_ZLIB=y
CONFIG_SQUASHFS_LZ4=y
CONFIG_SQUASHFS_LZO=y
CONFIG_SQUASHFS_XZ=y
CONFIG_SQUASHFS_ZSTD=y

CONFIG_ZRAM=m
CONFIG_ZRAM_DEF_COMP_LZORLE=y
# CONFIG_ZRAM_DEF_COMP_LZ4 is not set
# CONFIG_ZRAM_DEF_COMP_LZO is not set
# CONFIG_ZRAM_DEF_COMP_LZ4HC is not set
# CONFIG_ZRAM_DEF_COMP_842 is not set
CONFIG_ZRAM_DEF_COMP="lzo-rle"

CONFIG_ZSWAP=y
CONFIG_ZSMALLOC=y
CONFIG_ZSWAP_COMPRESSOR_DEFAULT_LZO=y
CONFIG_ZSWAP_COMPRESSOR_DEFAULT="lzo"
CONFIG_ZSWAP_ZPOOL_DEFAULT_ZBUD=y
CONFIG_ZSWAP_ZPOOL_DEFAULT="zbud"

# build netconsole as module to configure it with /etc/modprobe.d
CONFIG_NETCONSOLE=m

# NVME required on KBL NUC
CONFIG_NVME_CORE=y
CONFIG_BLK_DEV_NVME=y
# CONFIG_NVME_MULTIPATH is not set
CONFIG_NVME_FABRICS=m
CONFIG_NVME_FC=m

# USB3
CONFIG_USB_XHCI_HCD=m
CONFIG_USB_XHCI_DBGCAP=y
CONFIG_USB_XHCI_PCI=m
CONFIG_USB_XHCI_PLATFORM=m

# Gigabit Ethernet for MinnowBoard Turbot D0/ i211
CONFIG_IGB=m

# Override linux/arch/x86/configs/x86_64_deconfig:
# make them modules so they can be blocklisted when needed.
CONFIG_E100=m
CONFIG_E1000=m
CONFIG_E1000E=m

# WIFI
CONFIG_CFG80211_WEXT=y
CONFIG_MAC80211_RC_MINSTREL_VHT=y

CONFIG_WLAN_VENDOR_INTEL=y
# CONFIG_IPW2100 is not set
# CONFIG_IPW2200 is not set
# CONFIG_IWL4965 is not set
# CONFIG_IWL3945 is not set
CONFIG_IWLWIFI=m
CONFIG_IWLWIFI_LEDS=y
# CONFIG_IWLDVM is not set
CONFIG_IWLMVM=m
CONFIG_IWLWIFI_OPMODE_MODULAR=y
# CONFIG_IWLWIFI_BCAST_FILTERING is not set
# CONFIG_IWLWIFI_PCIE_RTPM is not set

#USB Net Adaptors (when WiFi fails)
CONFIG_USB_USBNET=m
CONFIG_USB_RTL8152=m

# MII PHY device drivers
CONFIG_ASIX_PHY=m

# MMC (taken from Ubuntu)
CONFIG_TIFM_CORE=m
CONFIG_CB710_CORE=m

CONFIG_MMC=y
CONFIG_MMC_BLOCK=m
CONFIG_MMC_BLOCK_MINORS=8
CONFIG_SDIO_UART=m
# CONFIG_MMC_TEST is not set

#
# MMC/SD/SDIO Host Controller Drivers
#
# CONFIG_MMC_DEBUG is not set
CONFIG_MMC_SDHCI=m
CONFIG_MMC_SDHCI_PCI=m
CONFIG_MMC_RICOH_MMC=y
CONFIG_MMC_SDHCI_ACPI=m
CONFIG_MMC_SDHCI_PLTFM=m
CONFIG_MMC_TIFM_SD=m
# CONFIG_MMC_SPI is not set
CONFIG_MMC_SDRICOH_CS=m
CONFIG_MMC_CB710=m
CONFIG_MMC_VIA_SDMMC=m
CONFIG_MMC_VUB300=m
CONFIG_MMC_USHC=m
CONFIG_MMC_USDHI6ROL0=m
CONFIG_MMC_TOSHIBA_PCI=m
# CONFIG_MMC_MTK is not set
# CONFIG_MMC_SDHCI_XENON is not set
# CONFIG_MEMSTICK is not set

# ELAN I2C touchpad support for Chromebooks
CONFIG_MOUSE_ELAN_I2C=m
CONFIG_MOUSE_ELAN_I2C_I2C=y
CONFIG_MOUSE_ELAN_SMBUS=y

# Touchpad support for ACER devices
CONFIG_HID_MULTITOUCH=m
CONFIG_ACPI_WMI=m
CONFIG_WMI_BMOF=m

# I2C touchpad (Dell, Asus and many other laptops)
CONFIG_I2C_HID=m
CONFIG_I2C_HID_ACPI=m
CONFIG_I2C_HID_CORE=m
CONFIG_INTEL_ISH_HID=m
CONFIG_INTEL_ISH_FIRMWARE_DOWNLOADER=m

# Touchpad support for Broadwell Samus (Pixelbook 2015)
CONFIG_TOUCHSCREEN_ATMEL_MXT=m
CONFIG_CHROME_PLATFORMS=y
CONFIG_CHROMEOS_LAPTOP=m
#CONFIG_CHROMEOS_PSTORE=m
#CONFIG_CROS_EC=m
#CONFIG_CROS_EC_LPC=m
#CONFIG_CROS_EC_PROTO=y
#CONFIG_CROS_KBD_LED_BACKLIGHT=m

# Suspend-resume support on Broadwell Samus (Pixelbook 2015)
CONFIG_TCG_TPM=y
CONFIG_TCG_TIS_CORE=y
CONFIG_TCG_TIS=y
CONFIG_HW_RANDOM_TPM=y

# Atheros WiFi
CONFIG_ATH_COMMON=m
CONFIG_WLAN_VENDOR_ATH=y
# CONFIG_ATH_DEBUG is not set
# CONFIG_ATH5K is not set
CONFIG_ATH5K_PCI=y
# CONFIG_ATH9K is not set
# CONFIG_ATH9K_HTC is not set
# CONFIG_CARL9170 is not set
# CONFIG_ATH6KL is not set
# CONFIG_AR5523 is not set
# CONFIG_WIL6210 is not set
CONFIG_ATH10K=m
CONFIG_ATH10K_CE=y
CONFIG_ATH10K_PCI=m
# CONFIG_ATH10K_SDIO is not set
# CONFIG_ATH10K_USB is not set
# CONFIG_ATH10K_DEBUG is not set
CONFIG_ATH10K_DEBUGFS=y
CONFIG_ATH10K_SPECTRAL=y
CONFIG_ATH10K_TRACING=y

# Touchpad fallback if i2c-hid is blacklisted (needed on some TGL devices)
CONFIG_INPUT_MOUSE=y
CONFIG_MOUSE_PS2=m

# Panda Wireless wants RT2800
CONFIG_RT2X00=m
CONFIG_RT2800USB=m
CONFIG_RT2800USB_RT33XX=y
CONFIG_RT2800USB_RT35XX=y
CONFIG_RT2800USB_RT3573=y
CONFIG_RT2800USB_RT53XX=y
CONFIG_RT2800USB_RT55XX=y
CONFIG_RT2800USB_UNKNOWN=y
```

## edison-defconfig
```kconfig
# CONFIG_DRM_I915 is not set
CONFIG_BACKLIGHT_LCD_SUPPORT=y
CONFIG_USB_XHCI_HCD=y
CONFIG_USB_DWC3=y
CONFIG_USB_DWC3_GADGET=y
CONFIG_GPIOLIB=y
CONFIG_GPIO_INTEL_MID=y
CONFIG_INTEL_MID_WATCHDOG=y
CONFIG_X86_EXTENDED_PLATFORM=y
CONFIG_X86_INTEL_MID=y
CONFIG_EFI_STUB=y
CONFIG_EARLY_PRINTK_EFI=y
CONFIG_HSU_DMA=y
CONFIG_HSU_DMA_PCI=y
CONFIG_SERIAL_8250_DMA=y
CONFIG_SERIAL_8250_MID=y
CONFIG_SERIAL_8250_PCI=y
```

## fuzz-defconfig
```kconfig
# code coverage collection
CONFIG_KCOV=y
CONFIG_KCOV_INSTRUMENT_ALL=y

# show code coverage in web interface
CONFIG_DEBUG_INFO=y

# KASAN for use-after-free and out-of-bounds detection
CONFIG_KASAN_INLINE=y

# Any other debugging configs
CONFIG_PROVE_LOCKING=y
CONFIG_PROVE_RCU=y

# Disable the following configs
# CONFIG_RANDOMIZE_BASE is not set

# Increase RCU stall timeout to reduce false positive rate
CONFIG_RCU_CPU_STALL_TIMEOUT=60

# PSTORE
CONFIG_PSTORE=m
CONFIG_EFI_VARS_PSTORE=m
CONFIG_PSTORE_DEFAULT_KMSG_BYTES=10240
CONFIG_PSTORE_DEFLATE_COMPRESS=m
CONFIG_PSTORE_COMPRESS=y
CONFIG_PSTORE_DEFLATE_COMPRESS_DEFAULT=y
CONFIG_PSTORE_COMPRESS_DEFAULT="deflate"
CONFIG_PSTORE_CONSOLE=y
CONFIG_PSTORE_PMSG=y
CONFIG_PSTORE_RAM=m
CONFIG_PSTORE_ZONE=m
CONFIG_PSTORE_BLK=m
CONFIG_PSTORE_BLK_BLKDEV=""
CONFIG_PSTORE_BLK_KMSG_SIZE=64
CONFIG_PSTORE_BLK_MAX_REASON=2
CONFIG_PSTORE_BLK_PMSG_SIZE=64
CONFIG_PSTORE_BLK_CONSOLE_SIZE=64
```

## hdaudio-codecs-defconfig
```kconfig
CONFIG_SND_HDA_INTEL=m

# enable HDaudio in SOF. this might be redundant with mach-driver-defconfig
CONFIG_SND_SOC_SOF_HDA_LINK=y
CONFIG_SND_SOC_SOF_HDA_AUDIO_CODEC=y

# switch to common HDMI codec (patch_hdmi.c)
CONFIG_SND_SOC_SOF_HDA_COMMON_HDMI_CODEC=y

# enable silent stream (aka Keep-Alive) for HDMI codec
CONFIG_SND_HDA_INTEL_HDMI_SILENT_STREAM=y

# machine driver for HDaudio support
CONFIG_SND_SOC_INTEL_SKL_HDA_DSP_GENERIC_MACH=m

# HDaudio configs
CONFIG_SND_HDA_INPUT_BEEP=y
CONFIG_SND_HDA_PATCH_LOADER=y
CONFIG_SND_HDA_CODEC_REALTEK=m
CONFIG_SND_HDA_CODEC_ANALOG=m
CONFIG_SND_HDA_CODEC_SIGMATEL=m
CONFIG_SND_HDA_CODEC_VIA=m
CONFIG_SND_HDA_CODEC_HDMI=m
CONFIG_SND_HDA_CODEC_CIRRUS=m
CONFIG_SND_HDA_CODEC_CONEXANT=m
CONFIG_SND_HDA_CODEC_CA0110=m
CONFIG_SND_HDA_CODEC_CA0132=m
CONFIG_SND_HDA_CODEC_CMEDIA=m
CONFIG_SND_HDA_CODEC_SI3054=m
CONFIG_SND_HDA_GENERIC=m
```

## lock-stall-defconfig
```kconfig
CONFIG_LOCKUP_DETECTOR=y

CONFIG_HARDLOCKUP_DETECTOR=y
CONFIG_HARDLOCKUP_DETECTOR_PERF=y

CONFIG_SOFTLOCKUP_DETECTOR=y

CONFIG_DETECT_HUNG_TASK=y

CONFIG_DEBUG_RT_MUTEXES=y
CONFIG_DEBUG_SPINLOCK=y
CONFIG_DEBUG_MUTEXES=y

CONFIG_DEBUG_RWSEMS=y

CONFIG_LOCKDEP=y
CONFIG_DEBUG_LOCK_ALLOC=y

CONFIG_LOCK_STAT=y

CONFIG_DEBUG_ATOMIC_SLEEP=y
CONFIG_WQ_WATCHDOG=y
```

## mach-driver-defconfig
```kconfig
CONFIG_SND_SOC_SOF_HDA_LINK=y
CONFIG_SND_SOC_SOF_HDA_AUDIO_CODEC=y

CONFIG_SND_SOC_INTEL_USER_FRIENDLY_LONG_NAMES=y

# Intel machine drivers supported by SOF and SST
CONFIG_SND_SOC_INTEL_BDW_RT5650_MACH=m
CONFIG_SND_SOC_INTEL_BDW_RT5677_MACH=m
CONFIG_SND_SOC_INTEL_BROADWELL_MACH=m
CONFIG_SND_SOC_INTEL_BYTCR_RT5640_MACH=m
CONFIG_SND_SOC_INTEL_BYTCR_RT5651_MACH=m
CONFIG_SND_SOC_INTEL_CHT_BSW_RT5672_MACH=m
CONFIG_SND_SOC_INTEL_CHT_BSW_RT5645_MACH=m
CONFIG_SND_SOC_INTEL_CHT_BSW_MAX98090_TI_MACH=m
CONFIG_SND_SOC_INTEL_CHT_BSW_NAU8824_MACH=m
CONFIG_SND_SOC_INTEL_BYT_CHT_DA7213_MACH=m
CONFIG_SND_SOC_INTEL_BYT_CHT_ES8316_MACH=m
CONFIG_SND_SOC_INTEL_BYT_CHT_CX2072X_MACH=m

# BYTCR-WM1502 drivers supported by SST and SOF
CONFIG_GPIO_ARIZONA=m
CONFIG_MFD_ARIZONA_SPI=m
CONFIG_REGULATOR_ARIZONA_LDO1=m
CONFIG_REGULATOR_ARIZONA_MICSUPP=m
CONFIG_SND_SOC_ARIZONA=m
CONFIG_EXTCON_ARIZONA=m
CONFIG_MFD_WM5102=y
CONFIG_SND_SOC_INTEL_BYTCR_WM5102_MACH=m

# Intel machine drivers only supported by SOF
CONFIG_SND_SOC_INTEL_SOF_PCM512x_MACH=m
CONFIG_SND_SOC_INTEL_SOF_WM8804_MACH=m
CONFIG_SND_SOC_INTEL_SOF_RT5682_MACH=m
CONFIG_SND_SOC_INTEL_SOF_CS42L42_MACH=m
CONFIG_SND_SOC_INTEL_GLK_DA7219_MAX98357A_MACH=m
CONFIG_SND_SOC_INTEL_GLK_RT5682_MAX98357A_MACH=m
CONFIG_SND_SOC_INTEL_CML_LP_DA7219_MAX98357A_MACH=m
CONFIG_SND_SOC_INTEL_SOF_CML_RT1011_RT5682_MACH=m
CONFIG_SND_SOC_INTEL_SOF_DA7219_MAX98373_MACH=m
CONFIG_SND_SOC_INTEL_EHL_RT5660_MACH=m
CONFIG_SND_SOC_INTEL_SOUNDWIRE_SOF_MACH=m
CONFIG_SND_SOC_INTEL_SOF_ES8336_MACH=m
CONFIG_SND_SOC_INTEL_SOF_NAU8825_MACH=m
CONFIG_SND_SOC_INTEL_SOF_SSP_AMP_MACH=m

# Intel machine drivers only supported in SST mode
CONFIG_SND_SOC_INTEL_HASWELL_MACH=m
CONFIG_SND_SOC_INTEL_SKL_RT286_MACH=m
CONFIG_SND_SOC_INTEL_SKL_NAU88L25_SSM4567_MACH=m
CONFIG_SND_SOC_INTEL_SKL_NAU88L25_MAX98357A_MACH=m
CONFIG_SND_SOC_INTEL_BXT_DA7219_MAX98357A_MACH=m
CONFIG_SND_SOC_INTEL_BXT_RT298_MACH=m
CONFIG_SND_SOC_INTEL_KBL_RT5663_MAX98927_MACH=m
CONFIG_SND_SOC_INTEL_KBL_RT5663_RT5514_MAX98927_MACH=m
CONFIG_SND_SOC_INTEL_KBL_DA7219_MAX98357A_MACH=m
CONFIG_SND_SOC_INTEL_KBL_DA7219_MAX98927_MACH=m
CONFIG_SND_SOC_INTEL_KBL_RT5660_MACH=m
```
