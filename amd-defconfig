## nobloat-imx-defconfig
```kconfig
# CONFIG_ARCH_AGILEX is not set
# CONFIG_ARCH_SUNXI is not set
# CONFIG_ARCH_ALPINE is not set
# CONFIG_ARCH_BCM2835 is not set
# CONFIG_ARCH_BCM_IPROC is not set
# CONFIG_ARCH_BERLIN is not set
# CONFIG_ARCH_BITMAIN is not set
# CONFIG_ARCH_REALTEK is not set
# CONFIG_ARCH_BRCMSTB is not set
# CONFIG_ARCH_EXYNOS is not set
# CONFIG_ARCH_K3 is not set
# CONFIG_ARCH_LAYERSCAPE is not set
# CONFIG_ARCH_LG1K is not set
# CONFIG_ARCH_HISI is not set
# CONFIG_ARCH_MEDIATEK is not set
# CONFIG_ARCH_MESON is not set
# CONFIG_ARCH_MVEBU is not set
# CONFIG_ARCH_QCOM is not set
# CONFIG_ARCH_RENESAS is not set
# CONFIG_ARCH_ROCKCHIP is not set
# CONFIG_ARCH_SEATTLE is not set
# CONFIG_ARCH_STRATIX10 is not set
# CONFIG_ARCH_SYNQUACER is not set
# CONFIG_ARCH_SPRD is not set
# CONFIG_ARCH_TEGRA is not set
# CONFIG_ARCH_THUNDER is not set
# CONFIG_ARCH_THUNDER2 is not set
# CONFIG_ARCH_UNIPHIER is not set
# CONFIG_ARCH_VEXPRESS is not set
# CONFIG_ARCH_XGENE is not set
# CONFIG_ARCH_ZX is not set
# CONFIG_ARCH_ZYNQMP is not set
# CONFIG_ARM_ARMADA_8K_CPUFREQ is not set
# CONFIG_ARM_MEDIATEK_CPUFREQ is not set
# CONFIG_ARM_QCOM_CPUFREQ_KRYO is not set
# CONFIG_ARM_QCOM_CPUFREQ_HW is not set
# CONFIG_VIRTUALIZATION is not set
# CONFIG_BT is not set
# CONFIG_RFKILL is not set
# CONFIG_NET_9P is not set
# CONFIG_DRM is not set
# CONFIG_DRM_DP_CEC is not set
# CONFIG_FB is not set
# CONFIG_IIO is not set
# CONFIG_WIRELESS is not set
# CONFIG_WLAN is not set
# CONFIG_USB_NET_DRIVERS is not set
# CONFIG_ACPI is not set
# CONFIG_SPMI is not set
# CONFIG_USB_SUPPORT is not set
# CONFIG_MMC is not set
# CONFIG_NEW_LEDS is not set
# CONFIG_MFD_CROS_EC is not set
# CONFIG_ARM64_CRYPTO is not set
# CONFIG_MD is not set
# CONFIG_VFIO is not set
# CONFIG_TEE is not set
# CONFIG_FPGA is not set
# CONFIG_CHROME_PLATFORMS is not set
# CONFIG_VIRTIO_PCI is not set
# CONFIG_VIRTIO_BALLOON is not set
# CONFIG_VIRTIO_MMIO is not set
# CONFIG_VIRTIO_PCI_LEGACY is not set
# CONFIG_XEN_NETDEV_FRONTEND is not set
# CONFIG_AT803X_PHY is not set
# CONFIG_MARVELL_PHY is not set
# CONFIG_MARVELL_10G_PHY is not set
# CONFIG_MICREL_PHY is not set
# CONFIG_MICROCHIP_PHY is not set
# CONFIG_ROCKCHIP_PHY is not set
# CONFIG_REALTEK_PHY is not set
# CONFIG_NETFILTER is not set
# CONFIG_BRIDGE is not set
# CONFIG_VLAN_8021Q is not set
# CONFIG_VLAN_8021Q_GVRP is not set
# CONFIG_VLAN_8021Q_MVRP is not set
# CONFIG_MEDIA_SUPPORT is not set
# CONFIG_RC_CORE is not set
CONFIG_IMX_DSP=y
```

## nocodec-defconfig
```kconfig
CONFIG_SND_SOC_SOF_HDA_LINK=y
CONFIG_SND_SOC_SOF_NOCODEC=m
CONFIG_SND_SOC_SOF_NOCODEC_SUPPORT=y
CONFIG_SND_SOC_SOF_FORCE_NOCODEC_MODE=y
```

## notrace-debugfs-defconfig
```kconfig
CONFIG_TRACING_SUPPORT=n
CONFIG_TRACING=n
CONFIG_DEBUG_FS=n
CONFIG_BLK_DEV_IO_TRACE=n
CONFIG_FTRACE=n
CONFIG_SYSFS=n
CONFIG_BLOCK=n
```

## sof-defconfig
```kconfig
# These configurations can be used by distros without issues

# Generic SOF selections
CONFIG_SND_SOC_SOF_TOPLEVEL=y
CONFIG_SND_SOC_SOF_PCI=m
CONFIG_SND_SOC_SOF_ACPI=m
CONFIG_SND_SOC_SOF_OF=m
CONFIG_SND_SOC_SOF_CLIENT_SUPPORT=y

# SOF Intel platform drivers
CONFIG_SND_SOC_SOF_INTEL_TOPLEVEL=y

#SOF i.MX platform drivers
CONFIG_SND_SOC_SOF_IMX_TOPLEVEL=y
CONFIG_SND_SOC_SOF_IMX8_SUPPORT=y
CONFIG_SND_SOC_SOF_IMX8M_SUPPORT=y

# SOF Mediatek platform drivers
CONFIG_SND_SOC_SOF_MTK_TOPLEVEL=y
CONFIG_SND_SOC_SOF_MT8195=m

# SOF Mediatek machine drivers
CONFIG_SND_SOC_MT8195=m
CONFIG_SND_SOC_MT8195_MT6359_RT1019_RT5682=m
```

## sof-dev-defconfig
```kconfig
# These configurations should not be used by distros but only by
# developers

# debug options
CONFIG_SND_SOC_SOF_DEVELOPER_SUPPORT=y
CONFIG_SND_SOC_SOF_DEBUG=y
CONFIG_SND_SOC_SOF_DEBUG_VERBOSE_IPC=y
CONFIG_SND_SOC_SOF_DEBUG_ENABLE_DEBUGFS_CACHE=y
CONFIG_SND_SOC_SOF_DEBUG_ENABLE_FIRMWARE_TRACE=y
CONFIG_SND_SOC_SOF_DEBUG_IPC_FLOOD_TEST=m
CONFIG_SND_SOC_SOF_DEBUG_PROBES=m
CONFIG_SND_SOC_SOF_DEBUG_IPC_MSG_INJECTOR=m
CONFIG_SND_SOC_SOF_DEBUG_RETAIN_DSP_CONTEXT=y
CONFIG_SND_SOC_SOF_NOCODEC_DEBUG_SUPPORT=y

# options to catch errors
CONFIG_UAPI_HEADER_TEST=y
CONFIG_HEADERS_INSTALL=y

# SOF Intel platform drivers no longer in development
CONFIG_SND_SOC_SOF_BAYTRAIL=m
CONFIG_SND_SOC_SOF_BROADWELL=m
CONFIG_SND_SOC_SOF_MERRIFIELD=m

# SOF Intel drivers still no longer in development
CONFIG_SND_SOC_SOF_KABYLAKE=m
CONFIG_SND_SOC_SOF_SKYLAKE=m
```

## sof-guest-defconfig
```kconfig
CONFIG_VIRTIO_BLK=y
CONFIG_VIRTIO_NET=m
CONFIG_VIRTIO_CONSOLE=y
CONFIG_HW_RANDOM_VIRTIO=m
CONFIG_DRM_VIRTIO_GPU=m
CONFIG_SND_SOC_INTEL_SKL_HDA_DSP_GENERIC_MACH=n
CONFIG_SND_SOC_SOF_NOCODEC_SUPPORT=y
CONFIG_SND_SOC_SOF_VIRTIO_FE=y
CONFIG_SND_SOC_SOF_DEBUG_FORCE_IPC_POSITION=y
CONFIG_SND_SOC_SOF_HDA_LINK=n
CONFIG_SND_SOC_SOF_HDA_AUDIO_CODEC=n
CONFIG_SND_SOC_DMIC=m
CONFIG_VIRTIO_PCI=y
CONFIG_VIRTIO_INPUT=m
CONFIG_VIRTIO_MMIO=m
CONFIG_VIRTIO_MMIO_CMDLINE_DEVICES=y
```

## sof-host-defconfig
```kconfig
CONFIG_TASKSTATS=n
CONFIG_TASK_DELAY_ACCT=n
CONFIG_KVM=m
CONFIG_KVM_INTEL=m
CONFIG_VHOST_NET=m
CONFIG_VHOST_SOF=y
CONFIG_BRIDGE=m
CONFIG_TUN=m
CONFIG_SND_SOC_SOF_DEBUG_FORCE_IPC_POSITION=y
```

## sof-mach-driver-defconfig
```kconfig
CONFIG_SND_SOC_SOF_HDA_LINK=y

# Intel machine drivers
CONFIG_SND_SOC_INTEL_HASWELL_MACH=m
CONFIG_SND_SOC_INTEL_BDW_RT5677_MACH=m
CONFIG_SND_SOC_INTEL_BROADWELL_MACH=m
CONFIG_SND_SOC_INTEL_BYTCR_RT5640_MACH=m
CONFIG_SND_SOC_INTEL_BYTCR_RT5651_MACH=m
CONFIG_SND_SOC_INTEL_CHT_BSW_RT5672_MACH=m
CONFIG_SND_SOC_INTEL_CHT_BSW_RT5645_MACH=m
CONFIG_SND_SOC_INTEL_CHT_BSW_MAX98090_TI_MACH=m
CONFIG_SND_SOC_INTEL_CHT_BSW_NAU8824_MACH=m
CONFIG_SND_SOC_INTEL_BYT_CHT_DA7213_MACH=m
CONFIG_SND_SOC_INTEL_BYT_CHT_ES8316_MACH=m
CONFIG_SND_SOC_INTEL_BXT_DA7219_MAX98357A_MACH=m
CONFIG_SND_SOC_INTEL_BXT_RT298_MACH=m
CONFIG_SND_SOC_INTEL_BXT_PCM512x_MACH=m
CONFIG_SND_SOC_INTEL_BXT_WM8804_MACH=m
CONFIG_SND_SOC_INTEL_GLK_RT5682_MAX98357A_MACH=m
CONFIG_SND_SOC_INTEL_SOF_RT5682_MACH=m
CONFIG_SND_SOC_INTEL_TGL_RT1308_MACH=m
```

## soundwire-codecs-defconfig
```kconfig
# add codecs so that they are compiled even if no machine
# drivers are selected
CONFIG_MFD_CS42L43_SDW=m
CONFIG_SND_SOC_CS35L56_SDW=m
CONFIG_SND_SOC_CS42L42_SDW=m
CONFIG_SND_SOC_CS42L43_SDW=m
CONFIG_SND_SOC_MAX98373_SDW=m

CONFIG_SND_SOC_RT1017_SDCA_SDW=m
CONFIG_SND_SOC_RT1308_SDW=m
CONFIG_SND_SOC_RT1316_SDW=m
CONFIG_SND_SOC_RT1318_SDW=m
CONFIG_SND_SOC_RT5682_SDW=m
CONFIG_SND_SOC_RT700_SDW=m
CONFIG_SND_SOC_RT711_SDW=m
CONFIG_SND_SOC_RT711_SDCA_SDW=m
CONFIG_SND_SOC_RT712_SDCA_SDW=m
CONFIG_SND_SOC_RT712_SDCA_DMIC_SDW=m
CONFIG_SND_SOC_RT722_SDCA_SDW=m
CONFIG_SND_SOC_RT715_SDW=m
CONFIG_SND_SOC_RT715_SDCA_SDW=m

# SoundWire mockup codec
CONFIG_SND_SOC_SDW_MOCKUP=m

# SoundWire SDCA library
CONFIG_SND_SOC_SDCA=m
```

## soundwire-defconfig
```kconfig
CONFIG_SOUNDWIRE=m
CONFIG_SOUNDWIRE_INTEL=m
CONFIG_SND_SOC_SOF_INTEL_SOUNDWIRE=m

CONFIG_SOUNDWIRE_AMD=m
```

## sst-defconfig
```kconfig
# CONFIG_SND_HDA_INTEL is not set
CONFIG_SND_SOC_INTEL_HASWELL=m
CONFIG_SND_SST_ATOM_HIFI2_PLATFORM_PCI=m
CONFIG_SND_SST_ATOM_HIFI2_PLATFORM_ACPI=m
CONFIG_SND_SOC_INTEL_SKYLAKE=m
CONFIG_SND_SOC_INTEL_SKYLAKE_HDAUDIO_CODEC=y
```

## telemetry-debugfs-defconfig
```kconfig
# configs for telemetry debugfs support

CONFIG_INTEL_IPS=m
CONFIG_INTEL_PMC_CORE=m
CONFIG_INTEL_PMC_IPC=m
CONFIG_INTEL_PUNIT_IPC=m
CONFIG_INTEL_TELEMETRY=m
```
